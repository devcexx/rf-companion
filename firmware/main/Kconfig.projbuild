## firmware/main/Kconfig.projbuild
```kconfig
menu "RF Companion Configuration"
    choice "RFAPP_TARGET_DEVICE"
        prompt "Target Device"
	help
	    Target device

        config RFAPP_TARGET_ESP32S3_DEVKIT
	    bool "ESP32-S3 DevKitC"
	config RFAPP_TARGET_ESP32S3_LOLIN_MINI
	    bool "ESP32-S3 Wemos LOLIN S3 Mini"
    endchoice
    config RFAPP_DEVO_MODE
        bool
	default n
        prompt "Enable development mode"
	help
	    This switch can be used for enabling specific logic that
	    should be enabled during development process, e.g specific
	    development BLE name for preventing clashes with the real
	    one, automatic pairing request approval, etc.

    config RFAPP_ENABLE_CC1101_SUPPORT
        bool
	default n
	prompt "Enable CC1101 support"
        help
	    Enables the support of using the CC1101 as an antenna,
	    instead of a simple STX882-like antenna.
endmenu
```
